## board/freescale/imx8mq_iwg33m/Kconfig
```kconfig
if TARGET_IMX8MQ_IWG33M

config SYS_BOARD
	default "imx8mq_iwg33m"

config SYS_VENDOR
	default "freescale"

config SYS_CONFIG_NAME
	default "imx8mq_iwg33m"

config FUSB302
	bool "fusb302 typec partial support"
	default n
source "board/freescale/common/Kconfig"

endif
```

## drivers/input/touchscreen/cst148/Kconfig
```kconfig
#
# Touchscreen driver configuration
#

config TOUCHSCREEN_HYNITRON_CST
	bool "Hynitron touchpanel"
	depends on I2C
	default n
	help
	Say Y here if you have cst1xx or cst3xx touch panel.

	If unsure, say N.

	To compile this dirver as a module, choose M here: the
	module will be called.
```
